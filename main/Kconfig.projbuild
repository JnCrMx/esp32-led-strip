## main/Kconfig.projbuild
```kconfig
menu "Pool Lantern Configuration"

    config EXAMPLE_MDNS_HOST_NAME
        string "mDNS Host Name"
        default "poollantern"
        help
            Specify the domain name used in the mDNS service.
            Note that webpage also take it as a part of URL where it will send GET/POST requests to.

    choice EXAMPLE_WEB_DEPLOY_MODE
        prompt "Website deploy mode"
        default EXAMPLE_WEB_DEPLOY_SEMIHOST
        help
            Select website deploy mode.
            You can deploy website to host, and ESP32 will retrieve them in a semihost way (JTAG is needed).
            You can deploy website to SD card or SPI flash, and ESP32 will retrieve them via SDIO/SPI interface.
            Detailed operation steps are listed in the example README file.
        config EXAMPLE_WEB_DEPLOY_SEMIHOST
            bool "Deploy website to host (JTAG is needed)"
            help
                Deploy website to host.
                It is recommended to choose this mode during developing.
        config EXAMPLE_WEB_DEPLOY_SD
            depends on IDF_TARGET_ESP32
            bool "Deploy website to SD card"
            help
                Deploy website to SD card.
                Choose this production mode if the size of website is too large (bigger than 2MB).
        config EXAMPLE_WEB_DEPLOY_SF
            bool "Deploy website to SPI Nor Flash"
            help
                Deploy website to SPI Nor Flash.
                Choose this production mode if the size of website is small (less than 2MB).
    endchoice

    if EXAMPLE_WEB_DEPLOY_SEMIHOST
        config EXAMPLE_HOST_PATH_TO_MOUNT
            string "Host path to mount (e.g. absolute path to web dist directory)"
            default "PATH-TO-WEB-DIST_DIR"
            help
                When using semihost in ESP32, you should specify the host path which will be mounted to VFS.
                Note that only absolute path is acceptable.
    endif

    config EXAMPLE_WEB_MOUNT_POINT
        string "Website mount point in VFS"
        default "/www"
        help
            Specify the mount point in VFS.
       
	menu "LEDC Configuration"
	
		config POOLLANTERN_GPIO_RED
			int "GPIO for the red LED"
			default 17
			help
				Specify the GPIO pin the red LED is connected to.
		
		config POOLLANTERN_GPIO_GREEN
			int "GPIO for the green LED"
			default 18
			help
				Specify the GPIO pin the green LED is connected to.
		
		config POOLLANTERN_GPIO_BLUE
			int "GPIO for the blue LED"
			default 19
			help
				Specify the GPIO pin the blue LED is connected to.
				
		config POOLLANTERN_LEDC_FREQUENCY
			int "LEDC PWM frequency"
			default 5000
			help
				Specify the PWM frequency for LEDC.
			
		config POOLLANTERN_LEDC_RESOLUTION
			int "LEDC duty resolution"
			default 8
			help
				Specify the duty resolution for LEDC.
		
	endmenu

endmenu
```
